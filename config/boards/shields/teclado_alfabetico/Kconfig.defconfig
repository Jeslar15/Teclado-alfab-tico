## config/boards/shields/teclado_alfabetico/Kconfig.defconfig
```kconfig
if SHIELD_TECLADO_ALFABETICO

config ZMK_KEYBOARD_NAME
    default "Teclado Naranja"

endif
```

## config/boards/shields/teclado_alfabetico/Kconfig.shield
```kconfig
config SHIELD_TECLADO_ALFABETICO
    def_bool $(shields_list_contains,teclado_alfabetico)
```
