#include <dt-bindings/zmk/matrix_transform.h>

/ {
    chosen {
        zmk,kscan = &kscan0;
    };

    kscan0: kscan_0 {
        compatible = "zmk,kscan-gpio-matrix";
        label = "KSCAN";
        diode-direction = "col2row";

        col-gpios
            = <&gpio1 11 GPIO_ACTIVE_HIGH>
            , <&gpio1 13 GPIO_ACTIVE_HIGH>
            , <&gpio0 29 GPIO_ACTIVE_HIGH> /* C3 Corregida */
            , <&gpio1 15 GPIO_ACTIVE_HIGH> /* C4 Corregida */
            , <&gpio0 2  GPIO_ACTIVE_HIGH> /* C5 Corregida */
            , <&gpio0 9  GPIO_ACTIVE_HIGH> /* C6 Actualizada al pin 009 */
            , <&gpio0 17 GPIO_ACTIVE_HIGH>
            , <&gpio0 8  GPIO_ACTIVE_HIGH>
            , <&gpio0 6  GPIO_ACTIVE_HIGH>
            , <&gpio0 31 GPIO_ACTIVE_HIGH>
            ;

        row-gpios
            = <&gpio1 4  (GPIO_ACTIVE_HIGH | GPIO_PULL_DOWN)>
            , <&gpio0 11 (GPIO_ACTIVE_HIGH | GPIO_PULL_DOWN)>
            , <&gpio1 0  (GPIO_ACTIVE_HIGH | GPIO_PULL_DOWN)>
            , <&gpio0 24 (GPIO_ACTIVE_HIGH | GPIO_PULL_DOWN)>
            , <&gpio0 22 (GPIO_ACTIVE_HIGH | GPIO_PULL_DOWN)>
            , <&gpio0 20 (GPIO_ACTIVE_HIGH | GPIO_PULL_DOWN)>
            ;
    };
};
